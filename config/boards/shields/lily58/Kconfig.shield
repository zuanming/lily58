## config/boards/shields/lily58/Kconfig.shield
```kconfig
config SHIELD_LILY58_LEFT_ENCODER
    def_bool $(shields_list_contains,lily58_left_encoder)

config SHIELD_LILY58_RIGHT_ENCODER
    def_bool $(shields_list_contains,lily58_right_encoder)

config SHIELD_LILY58_LEFT_ENCODER_MAIN
    def_bool $(shields_list_contains,lily58_left_encoder)
```

## config/west.yml
```yaml
manifest:
  remotes:
    - name: zmkfirmware
      url-base: https://github.com/zmkfirmware
    - name: zuanming
      url-base: https://github.com/zuanming
  projects:
    - name: zmk
      remote: zmkfirmware
      revision: v0.3
      import: app/west.yml
    - name: zmk-oled-adapter
      remote: zuanming
      revision: main
    - name: zmk-nice-oled
      remote: zuanming
      revision: main
    - name: zmk-dongle
      remote: zuanming
      revision: main
    - name: zmk-dongle-display
      remote: zuanming
      revision: main  
    - name: nice-view-battery                
      remote: zuanming                       
      revision: main   
  self:
    path: config
```
